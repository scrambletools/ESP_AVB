## components/esp_avb/Kconfig.projbuild
```kconfig
menu "AVB Configuration"

    config ESP_AVB
        bool "Enable AVB"
        default y
        depends on NETUTILS_PTPD
        help
            Enable Audio Video Bridging (AVB) support.
            AVB provides time-synchronized, low-latency streaming services 
            through IEEE 802.1 standards. This option requires 
            PTP daemon (PTPD) for time synchronization.

    if ESP_AVB

        config ESP_AVB_DEBUG
            bool "Enable AVB debug messages"
            default n
            depends on DEBUG_INFO
            help
                Enable debug messages for AVB functionality.

        config ESP_AVB_TALKER
            bool "Enable AVB talker"
            default y
            help
                Act as an AVB talker (stream source)

        config ESP_AVB_LISTENER
            bool "Enable AVB listener"
            default y
            help
                Act as an AVB listener (stream sink)

        config ESP_AVB_STACKSIZE
            int "AVB stack size"
            default 6144 # DEFAULT_TASK_STACKSIZE
            help
                Set the stack size for the AVB task.

        config ESP_AVB_TASKPRIO
            int "AVB task priority"
            default 20
            help
                Set the priority for the AVB task.

        config ESP_AVB_MSRP_DOMAIN
            int "MSRP domain"
            default 1
            range 0 4095
            help
                Set MSRP domain for AVB stream registration.
                According to IEEE 802.1Q-2018, the default MSRP domain for AVB is 1.
                Values 0-4095 are valid, but domain 1 is reserved for AVB usage.
    
        config ESP_AVB_VLAN_ID
            int "AVB VLAN ID"
            default 2
            range 1 4094
            help
                Set VLAN ID for AVB traffic.
                According to IEEE 802.1Q-2018, the default VLAN ID for AVB is 2.
                SR Class A and SR Class B traffic must use priority tagged VLANs.
                Values 1-4094 are valid, but VLAN 2 is commonly used for AVB.

        config ESP_AVB_VLAN_PRIO_CLASS_A
            int "AVB Class A VLAN Priority"
            default 3
            range 0 7
            help
                Set VLAN Priority Code Point (PCP) for Class A streams.
                According to IEEE 802.1Q-2018:
                - PCP 3 is used for Credit-Based Shaper (CBS) traffic class A
                - Class A has more stringent latency requirements (2ms)

        config ESP_AVB_VLAN_PRIO_CLASS_B
            int "AVB Class B VLAN Priority"
            default 2
            range 0 7
            help
                Set VLAN Priority Code Point (PCP) for Class B streams.
                According to IEEE 802.1Q-2018:
                - PCP 2 is used for Credit-Based Shaper (CBS) traffic class B
                - Class B has less stringent latency requirements (50ms)

    endif # NETUTILS_ESP_AVB

endmenu # ESP_AVB Configuration
```

## main/Kconfig.projbuild
```kconfig
menu "AVB Example Configuration"

    orsource "$IDF_PATH/examples/common_components/env_caps/$IDF_TARGET/Kconfig.env_caps"
    
    config EXAMPLE_AVB_ENTITY_NAME
        string "Entity Name"
        default "AVB Example Entity"
        help
            Set the name of the AVB entity. This name will be used to identify this device
            in the AVB network.

    config EXAMPLE_AVB_ENTITY_MODEL_ID
        int "Entity Model ID"
        default 0
        range 0 1000000
        help
            Set the model ID for this AVB entity. This ID should uniquely identify the model/type
            of AVB device within your vendor's product line.

    config EXAMPLE_AVB_TALKER
        bool "Function as AVB Talker"
        default true
        help
            Function as AVB Talker.

    config EXAMPLE_AVB_LISTENER
        bool "Function as AVB Listener"
        default true
        help
            Function as AVB Listener.

    if EXAMPLE_AVB_LISTENER

        config EXAMPLE_AVB_LISTENER_AUTO_CONNECT
            bool "Auto Connect"
            default false
            help
                Automatically connect to an AVB Talker with the same entity model ID.

    endif

    config EXAMPLE_AVB_SPEAKER_VOLUME
        string "Speaker volume"
        range 0 100
        default 80
        depends on EXAMPLE_AVB_LISTENER
        help
            Set the volume of the speaker.

    choice EXAMPLE_SELECT_MIC_GAIN
        prompt "Set MIC gain"
        depends on EXAMPLE_AVB_TALKER
        default MIC_GAIN_18DB
        help
            Select mic gain for echo mode

        config MIC_GAIN_0DB
            bool "0dB"
        config MIC_GAIN_6DB
            bool "6dB"
        config MIC_GAIN_12DB
            bool "12dB"
        config MIC_GAIN_18DB
            bool "18dB"
        config MIC_GAIN_24DB
            bool "24dB"
        config MIC_GAIN_30DB
            bool "30dB"
        config MIC_GAIN_36DB
            bool "36dB"
        config MIC_GAIN_42DB
            bool "42dB"
    endchoice

    config EXAMPLE_AVB_MIC_GAIN
        int
        default 0 if MIC_GAIN_0DB
        default 1 if MIC_GAIN_6DB
        default 2 if MIC_GAIN_12DB
        default 3 if MIC_GAIN_18DB
        default 4 if MIC_GAIN_24DB
        default 5 if MIC_GAIN_30DB
        default 6 if MIC_GAIN_36DB
        default 7 if MIC_GAIN_42DB

    config EXAMPLE_AVB_ATDECC
        bool "Allow remote control via ATDECC"
        default true
        help
            Allow an AVB Controller to control this device via ATDECC protocol.

    config EXAMPLE_AVB_PULSE_GPIO
        int "GPIO for pulse"
        default 20
        help
            GPIO to use for PTP pulse.

    config EXAMPLE_AVB_PULSE_WIDTH_NS
        int "Pulse width"
        default 250000000
        help
            Pulse width for PTP pulse.

endmenu
```

## sdkconfig.defaults
```kconfig
CONFIG_IDF_TARGET="esp32p4"

CONFIG_ESPTOOLPY_FLASHSIZE_16MB=y
CONFIG_ESPTOOLPY_FLASHSIZE="16MB"

CONFIG_ESP_NETIF_L2_TAP=y

CONFIG_EXAMPLE_USE_INTERNAL_ETHERNET=y
CONFIG_EXAMPLE_ETH_PHY_IP101=y

CONFIG_NETUTILS_PTPD=y
CONFIG_NETUTILS_PTPD_CLIENT=y
CONFIG_NETUTILS_PTPD_SERVER=y

CONFIG_NETUTILS_PTPD_PRIORITY1=246
CONFIG_NETUTILS_PTPD_SERVERPRIO=100
CONFIG_NETUTILS_PTPD_TIMEOUT_MS=10000
CONFIG_NETUTILS_PTPD_SETTIME_THRESHOLD_MS=100

CONFIG_CODEC_I2C_BACKWARD_COMPATIBLE=n

CONFIG_FREERTOS_ISR_STACKSIZE=6144

# Disable task WDT for CPU1 idle task — AVB-OUT runs at max priority on
# core 1 and starves IDLE1 by design during real-time streaming.
CONFIG_ESP_TASK_WDT_CHECK_IDLE_TASK_CPU1=n

# Disable Ethernet transmit mutex — AVB sockets use the non-timestamped
# transmit path (microsecond DMA descriptor setup only). The PTP daemon
# still uses timestamped transmit on its own socket, but the brief overlap
# risk is acceptable vs the priority inversion caused by the mutex.
CONFIG_ETH_TRANSMIT_MUTEX=n

CONFIG_FREERTOS_GENERATE_RUN_TIME_STATS=y

# Increase EMAC DMA RX buffers and L2TAP queue for high-bandwidth AVB
# listener streams (8000 pkt/sec for Class A 8-channel AM824).
CONFIG_ETH_DMA_RX_BUFFER_NUM=30
CONFIG_ESP_NETIF_L2_TAP_RX_QUEUE_SIZE=64
CONFIG_ETH_DMA_BUFFER_SIZE=512
```
